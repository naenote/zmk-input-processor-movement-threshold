## Kconfig
```kconfig
config ZMK_INPUT_PROCESSOR_MOVEMENT_THRESHOLD
  bool "Movement threshold filter input processor"
  depends on ZMK_POINTING
  default y if DT_HAS_ZMK_INPUT_PROCESSOR_MOVEMENT_THRESHOLD_ENABLED

config ZMK_INPUT_PROCESSOR_MOVEMENT_DROP
  bool "Movement drop input processor"
  depends on ZMK_POINTING
  default y if DT_HAS_ZMK_INPUT_PROCESSOR_MOVEMENT_DROP_ENABLED

config ZMK_INPUT_PROCESSOR_MOVEMENT_SUSTAIN
  bool "Sustained movement filter input processor"
  depends on ZMK_POINTING
  default y if DT_HAS_ZMK_INPUT_PROCESSOR_MOVEMENT_SUSTAIN_ENABLED
```

## dts/bindings/input/zmk,input-processor-movement-drop.yaml
```yaml
description: |
  Stops X/Y movement events from propagating further in the processor chain,
  preventing HID pointer updates while leaving scroll and button events unaffected.

  Intended as the final processor in a dedicated AML-only input listener, so that
  AML-activating processors (e.g. zip_temp_layer) run for large movements but the
  HID report is never updated from that listener (avoiding double pointer movement).

  Usage example — place last in the AML listener's processor chain:
    zip_movement_drop: zip_movement_drop {
        compatible = "zmk,input-processor-movement-drop";
        #input-processor-cells = <0>;
    };
    // In AML listener: <&zip_movement_threshold 8>, <&zip_temp_layer MOUSE 300>, <&zip_movement_drop>

compatible: "zmk,input-processor-movement-drop"

properties:
  "#input-processor-cells":
    type: int
    const: 0

input-processor-cells: []
```

## dts/bindings/input/zmk,input-processor-movement-sustain.yaml
```yaml
description: |
  Passes X/Y movement events only after the movement has been sustained for at
  least param1 milliseconds. The measurement restarts when no movement event has
  arrived for param2 milliseconds.

  A keystroke shock jolts the ball for a single short burst of reports and is
  filtered out; deliberate pointer movement lasts long enough to pass. Unlike a
  pure magnitude threshold this discriminates by how long the movement lasts, so
  it is not defeated by a hard knock.

  Events before the duration is reached are consumed (ZMK_INPUT_PROC_STOP),
  which also stops the HID update — use this in an AML-only listener, never in
  the listener that drives the pointer.

  Usage example:
    zip_movement_sustain: zip_movement_sustain {
        compatible = "zmk,input-processor-movement-sustain";
        #input-processor-cells = <2>;
    };
    // In AML listener: <&zip_movement_sustain 60 150>
    //   param1 = 60  : movement must last 60ms before AML may trigger
    //   param2 = 150 : a 150ms pause in movement restarts the measurement

compatible: "zmk,input-processor-movement-sustain"

properties:
  "#input-processor-cells":
    type: int
    const: 2
  track-remainders:
    type: boolean

# NOTE: the cell names MUST be `param1`/`param2` — ZMK looks them up by those
# exact names and silently substitutes 0 for anything else.
input-processor-cells:
  - param1
  - param2
```
